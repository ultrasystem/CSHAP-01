## arch/arm/plat-samsung/Kconfig.rej
```kconfig
***************
*** 78,83 ****
  
  # clock options
  
  config SAMSUNG_CLKSRC
  	bool
  	help
--- 78,87 ----
  
  # clock options
  
+ config SAMSUNG_CLOCK
+ 	bool
+ 	default y if !COMMON_CLK
+ 
  config SAMSUNG_CLKSRC
  	bool
  	help
***************
*** 399,405 ****
  
  config S3C24XX_PWM
  	bool "PWM device support"
- 	select HAVE_PWM
  	help
  	  Support for exporting the PWM timer blocks via the pwm device
  	  system
--- 403,410 ----
  
  config S3C24XX_PWM
  	bool "PWM device support"
+ 	select PWM
+ 	select PWM_SAMSUNG
  	help
  	  Support for exporting the PWM timer blocks via the pwm device
  	  system
***************
*** 491,504 ****
  	  Internal config node to apply common S5P sleep management code.
  	  Can be selected by S5P and newer SoCs with similar sleep procedure.
  
- comment "Power Domain"
- 
- config SAMSUNG_PD
- 	bool "Samsung Power Domain"
- 	depends on PM_RUNTIME
- 	help
- 	  Say Y here if you want to control Power Domain by Runtime PM.
- 
  config DEBUG_S3C_UART
  	depends on PLAT_SAMSUNG
  	int
--- 496,501 ----
  	  Internal config node to apply common S5P sleep management code.
  	  Can be selected by S5P and newer SoCs with similar sleep procedure.
  
  config DEBUG_S3C_UART
  	depends on PLAT_SAMSUNG
  	int
```

## drivers/Kconfig.rej
```kconfig
***************
*** 150,153 ****
  
  source "drivers/vme/Kconfig"
  
  endmenu
--- 152,157 ----
  
  source "drivers/vme/Kconfig"
  
+ source "drivers/pwm/Kconfig"
+ 
  endmenu
```

## drivers/autopilot/Kconfig
```kconfig
menuconfig AUTOPILOT
	tristate "Provides a framework for autopilot system"
	help
	  If you don't know what to do here, say N.

if AUTOPILOT

config OBJECT_MEMORY
        tristate "Object memory for uORB module"
        depends on ASHMEM
        default y
        ---help---
         Create or Open the memory for uORB module

config AUTOPILOT_ETSAIRSPEED
	tristate "Eagle Tree Systems Airspeed MicroSensor V3"
	depends on OBJECT_MEMORY
	---help---
          Driver for the Eagle Tree Airspeed V3 connected via I2C.

endif
```

## drivers/hwmon/Kconfig.rej
```kconfig
***************
*** 314,319 ****
  	  This driver can also be built as a module.  If so, the module
  	  will be called ds1621.
  
  config SENSORS_EXYNOS4_TMU
  	tristate "Temperature sensor on Samsung EXYNOS4"
  	depends on ARCH_EXYNOS4
--- 314,329 ----
  	  This driver can also be built as a module.  If so, the module
  	  will be called ds1621.
  
+ config SENSORS_DA9052_ADC
+ 	tristate "Dialog DA9052/DA9053 ADC"
+ 	depends on PMIC_DA9052
+ 	help
+ 	  Say y here to support the ADC found on Dialog Semiconductor
+ 	  DA9052-BC and DA9053-AA/Bx PMICs.
+ 
+ 	  This driver can also be built as module. If so, the module
+ 	  will be called da9052-hwmon.
+ 
  config SENSORS_EXYNOS4_TMU
  	tristate "Temperature sensor on Samsung EXYNOS4"
  	depends on ARCH_EXYNOS4
```

## drivers/staging/android/Kconfig.rej
```kconfig
***************
*** 44,54 ****
  	tristate "Android log driver"
  	default n
  
- config ANDROID_RAM_CONSOLE
- 	bool "Android RAM buffer console"
- 	depends on !S390 && !UML && HAVE_MEMBLOCK && PSTORE_RAM=y
- 	default n
- 
  config ANDROID_TIMED_OUTPUT
  	bool "Timed output class driver"
  	default y
--- 44,49 ----
  	tristate "Android log driver"
  	default n
  
  config ANDROID_TIMED_OUTPUT
  	bool "Timed output class driver"
  	default y
```
